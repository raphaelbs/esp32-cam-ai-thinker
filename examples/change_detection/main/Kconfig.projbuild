## examples/change_detection/main/Kconfig.projbuild
```kconfig
menu "Example configuration"

  menu "Camera configuration"

    config XCLK_FREQ
      int "XCLK Frequency"
      default "20000000"
      help
          The XCLK Frequency in Herz.
          
    menu "Pin Configuration"
      config D0
        int "D0"
        default "5"
      config D1
        int "D1"
        default "18"
      config D2
        int "D2"
        default "19"
      config D3
        int "D3"
        default "21"
      config D4
        int "D4"
        default "36"
      config D5
        int "D5"
        default "39"
      config D6
        int "D6"
        default "34"
      config D7
        int "D7"
        default "35"
      config XCLK
        int "XCLK"
        default "0"
      config PCLK
        int "PCLK"
        default "22"
      config VSYNC
        int "VSYNC"
        default "25"
      config HREF
        int "HREF"
        default "23"
      config SDA
        int "SDA"
        default "26"
      config SCL
        int "SCL"
        default "27"
      config RESET
        int "RESET"
        default "32"
    endmenu

  endmenu
	
  menu "Detection configuration"

    config MAX_ACCEPTED_AVG_DIFF
      int "Maximum accepted average difference"
      default 7
      help
            For every QQVGA grayscale picture taken, an average is calculated. If absolute(new average - the previous average) > MAX_ACCEPTED_AVG_DIFF, it takes a full QXVGA Jpeg picture.

    config PICTURE_QUEUE_SIZE
      int "Picture queue size" 
      default 7
      help
            Every time a new QXVGA picture is taken, send to the queue. This configuration represents the maximum size allowed to the queue.

  endmenu
endmenu
```

## examples/change_detection/sdkconfig.defaults
```kconfig
#
# Compiler options DEBUG
#
CONFIG_OPTIMIZATION_LEVEL_DEBUG=y
CONFIG_OPTIMIZATION_ASSERTIONS_ENABLED=y
CONFIG_STACK_CHECK_ALL=y
CONFIG_STACK_CHECK=y
CONFIG_WARN_WRITE_STRINGS=y
CONFIG_LOG_DEFAULT_LEVEL_DEBUG=y

#
# ESP32-specific
#
CONFIG_SPIRAM_SUPPORT=y
CONFIG_SPIRAM_IGNORE_NOTFOUND=y
CONFIG_WIFI_LWIP_ALLOCATION_FROM_SPIRAM_FIRST=y
CONFIG_SPIRAM_TYPE_ESPPSRAM64=y
```

## examples/google_storage/sdkconfig.defaults
```kconfig
#
# Compiler options DEBUG
#
CONFIG_OPTIMIZATION_LEVEL_DEBUG=y
CONFIG_OPTIMIZATION_ASSERTIONS_ENABLED=y
CONFIG_STACK_CHECK_ALL=y
CONFIG_STACK_CHECK=y
CONFIG_WARN_WRITE_STRINGS=y
CONFIG_LOG_DEFAULT_LEVEL_DEBUG=y

#
# Serial flasher config
#
CONFIG_ESPTOOLPY_BAUD_230400B=y

#
# ESP32-specific
#
CONFIG_SPIRAM_SUPPORT=y
CONFIG_SPIRAM_IGNORE_NOTFOUND=y
CONFIG_WIFI_LWIP_ALLOCATION_FROM_SPIRAM_FIRST=y
CONFIG_SPIRAM_TYPE_ESPPSRAM64=y
CONFIG_ESP32_REV_MIN_0=n
CONFIG_ESP32_REV_MIN_1=y

# Override some defaults so BT stack is enabled and
CONFIG_BT_ENABLED=y
CONFIG_BTDM_CTRL_MODE_BLE_ONLY=y
CONFIG_BTDM_CTRL_MODE_BR_EDR_ONLY=
CONFIG_BTDM_CTRL_MODE_BTDM=
CONFIG_BT_NIMBLE_ENABLED=y

# Binary is larger than default size
CONFIG_PARTITION_TABLE_CUSTOM=y
CONFIG_PARTITION_TABLE_CUSTOM_FILENAME="partitions.csv"
CONFIG_PARTITION_TABLE_FILENAME="partitions.csv"
```

## examples/http_jpg/src/Kconfig.projbuild
```kconfig
menu "Example configuration"

  menu "Wifi Configuration"
    config WIFI_SSID
      string "Wifi SSID"
    config WIFI_PASSWORD
      string "Wifi password"
  endmenu

  menu "Camera configuration"

    config XCLK_FREQ
      int "XCLK Frequency"
      default "20000000"
      help
        The XCLK Frequency in Herz.
          
    menu "Pin Configuration"
      config D0
        int "D0"
        default "5"
      config D1
        int "D1"
        default "18"
      config D2
        int "D2"
        default "19"
      config D3
        int "D3"
        default "21"
      config D4
        int "D4"
        default "36"
      config D5
        int "D5"
        default "39"
      config D6
        int "D6"
        default "34"
      config D7
        int "D7"
        default "35"
      config XCLK
        int "XCLK"
        default "0"
      config PCLK
        int "PCLK"
        default "22"
      config VSYNC
        int "VSYNC"
        default "25"
      config HREF
        int "HREF"
        default "23"
      config SDA
        int "SDA"
        default "26"
      config SCL
        int "SCL"
        default "27"
      config RESET
        int "RESET"
        default "-1"
      config PWDN
        int "PWDN"
        default "32"
    endmenu

    config OV2640_SUPPORT
      bool "OV2640 Support"
      default y
      help
        Enable this option if you want to use the OV2640.
        Disable this option to save memory.

    config OV7725_SUPPORT
      bool "OV7725 Support"
      default n
      help
        Enable this option if you want to use the OV7725.
        Disable this option to save memory.

    config OV3660_SUPPORT
      bool "OV3660 Support"
      default n
      help
        Enable this option if you want to use the OV3360.
        Disable this option to save memory.

    config OV5640_SUPPORT
      bool "OV5640 Support"
      default n
      help
        Enable this option if you want to use the OV5640.
        Disable this option to save memory.

    choice CAMERA_TASK_PINNED_TO_CORE
      bool "Camera task pinned to core"
      default CAMERA_CORE0
      help
        Pin the camera handle task to a certain core(0/1). It can also be done automatically choosing NO_AFFINITY.

      config CAMERA_CORE0
        bool "CORE0"
      config CAMERA_CORE1
        bool "CORE1"
      config CAMERA_NO_AFFINITY
        bool "NO_AFFINITY"

    endchoice

  endmenu
	
endmenu
```
